## Kconfig
```kconfig
menu "CORE CORE Configuration"
    config COM_LOG_STATIC_LIB
        bool "Enable COM LOG static lib"
        default n
        help
            nable COM LOG static lib
    config COM_OSAL_STATIC_LIB
        bool "Enable COM OSAL static lib"
        default n
        help
            nable COM OSAL static lib
endmenu
```
